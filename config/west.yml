## config/west.yml
```yaml
manifest:
  remotes:
    - name: zmkfirmware
      url-base: https://github.com/zmkfirmware
    - name: zephyrproject
      url-base: https://github.com/zephyrproject-rtos
  projects:
    - name: zmk
      remote: zmkfirmware
      revision: main # または特定のコミット/ブランチ
      import: app/west.yml
    - name: zephyr
      remote: zephyrproject
      revision: main # または特定のバージョン（例: 
```
