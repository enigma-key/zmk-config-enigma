#include <seeeduino_xiao_ble_nrf52840.dtsi>

/ {
    model = "Enigma";
    compatible = "zmk,keymap";

    chosen {
        zmk,kscan = &kscan0;
        zmk,matrix_transform = &default_transform;
    };

    kscan0: kscan {
        compatible = "zmk,kscan-gpio-matrix";
        label = "KSCAN";
        diode-direction = "row2col";
        rows = <4>;
        cols = <10>;
        row-gpios
            = <&gpio0 2 GPIO_ACTIVE_LOW>   // P0.02 (D0)
            , <&gpio0 10 GPIO_ACTIVE_LOW>  // P0.10 (D15)
            , <&gpio1 12 GPIO_ACTIVE_LOW>  // P1.12 (D7)
            , <&gpio1 15 GPIO_ACTIVE_LOW>; // P1.15 (D10)
        col-gpios
            = <&gpio0 15 GPIO_ACTIVE_HIGH> // P0.15 (D11)
            , <&gpio0 3 GPIO_ACTIVE_HIGH>  // P0.03 (D1)
            , <&gpio0 19 GPIO_ACTIVE_HIGH> // P0.19 (D12)
            , <&gpio0 28 GPIO_ACTIVE_HIGH> // P0.28 (D2)
            , <&gpio1 1 GPIO_ACTIVE_HIGH>  // P1.01 (D13)
            , <&gpio0 29 GPIO_ACTIVE_HIGH> // P0.29 (D3)
            , <&gpio0 9 GPIO_ACTIVE_HIGH>  // P0.09 (D14)
            , <&gpio0 4 GPIO_ACTIVE_HIGH>  // P0.04 (D4)
            , <&gpio1 13 GPIO_ACTIVE_HIGH> // P1.13 (D8)
            , <&gpio1 14 GPIO_ACTIVE_HIGH>;// P1.14 (D9)
    };
};​​​​​​​​​​​​​​​​​​​​​​​​​​​​​​​​​​​​​​​​​​​​​​​​​​
